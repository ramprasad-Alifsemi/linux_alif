## Documentation/devicetree/bindings/hwlock/alif,hwsem.yaml
```yaml
# SPDX-License-Identifier: (GPL-2.0 OR BSD-2-Clause)
%YAML 1.2
---
$id: http://devicetree.org/schemas/hwlock/alif,hwsem.yaml#
$schema: http://devicetree.org/meta-schemas/core.yaml#

title: Alif Ensemble Hardware Semaphore (HWSEM) Controller

description: Alif Ensemble Hardware Semaphore (HWSEM) controller

maintainers:
  - Hemanth Kumar <hemanth@alifsemi.com>

properties:
  compatible:
    const: alif,hwsem

  reg:
    maxItems: 1
    description: Register address of hardware semaphore.

  reg-names:
    items:
      - const: hwsem_base
    description: Names for the register areas.

  interrupts:
    maxItems: 1
    description: List of interrupt numbers.

  clocks:
    maxItems: 1
    description: Must contain an entry for each entry in clock-names.

  clock-names:
    items:
      - const: syst_pclk
    description: Should be "syst_pclk" to match clocks phandles list.

required:
  - compatible
  - reg
  - reg-names
  - interrupts
  - clocks
  - clock-names

additionalProperties: false

examples:
  - |
    #include <dt-bindings/clock/alif,ensemble-clock.h>

    hwsem0: hwlock@4902e000 {
        compatible = "alif,hwsem";
        reg = <0x4902e000 0x4>;
        reg-names = "hwsem_base";
        interrupts = <0 30 4>;
        clocks = <&psclks ENSEMBLE_SYST_PCLK>;
        clock-names = "syst_pclk";
    };
```

## Documentation/devicetree/bindings/iio/adc/alif,adc.yaml
```yaml
# SPDX-License-Identifier: (GPL-2.0-only OR BSD-2-Clause)
%YAML 1.2
---
$id: http://devicetree.org/schemas/iio/adc/alif,adc.yaml#
$schema: http://devicetree.org/meta-schemas/core.yaml#

title: Alif Ensemble ADC12/ADC24 Controller

maintainers:
  - Pankaj Pandey <pankaj.pandey@alifsemi.com>

description: |
  The Alif Ensemble platform integrates multiple ADC controllers:
  - ADC12 instances (12-bit ADC, multiple channels, multiple interrupts)
  - ADC24 instance (24-bit ADC, multiple interrupts)

  Each ADC block supports a set of interrupts and requires an
  associated functional clock.

properties:
  compatible:
    const: alif,adc-dev

  reg:
    minItems: 1
    maxItems: 2
    description: Register base and size of the ADC instance. Optional
      second region is the comparator register base.

  reg-names:
    minItems: 1
    items:
      - const: adc_base
      - const: cmp_base

  interrupts:
    minItems: 4
    maxItems: 4
    description: |
      Four interrupts per ADC instance, ordered as documented in TRM:
      - End-of-conversion
      - FIFO threshold
      - Overflow
      - Error

  clocks:
    maxItems: 1
    description: Reference clock for ADC controller.

  clock-names:
    const: adc_clk

required:
  - compatible
  - reg
  - reg-names
  - interrupts
  - clocks
  - clock-names

additionalProperties: false

examples:
  - |
    #include <dt-bindings/clock/alif,ensemble-clock.h>
    #include <dt-bindings/interrupt-controller/irq.h>

    adc12_0: adc@49020000 {
        compatible = "alif,adc-dev";
        reg-names = "adc_base", "cmp_base";
        reg = <0x49020000 0x100>,
              <0x49023000 0x10>;
        interrupt-parent = <&gic>;
        interrupts = <0 140 IRQ_TYPE_LEVEL_HIGH>,
                     <0 143 IRQ_TYPE_LEVEL_HIGH>,
                     <0 146 IRQ_TYPE_LEVEL_HIGH>,
                     <0 149 IRQ_TYPE_LEVEL_HIGH>;
        clocks = <&psclks ENSEMBLE_ADC120_CLK>;
        clock-names = "adc_clk";
    };

    adc24: adc@49027000 {
        compatible = "alif,adc-dev";
        reg-names = "adc_base", "cmp_base";
        reg = <0x49027000 0x100>,
              <0x49023000 0x10>;
        interrupt-parent = <&gic>;
        interrupts = <0 152 IRQ_TYPE_LEVEL_HIGH>,
                     <0 153 IRQ_TYPE_LEVEL_HIGH>,
                     <0 154 IRQ_TYPE_LEVEL_HIGH>,
                     <0 155 IRQ_TYPE_LEVEL_HIGH>;
        clocks = <&psclks ENSEMBLE_ADC24_CLK>;
        clock-names = "adc_clk";
    };
```

## Documentation/devicetree/bindings/iio/dac/alif,ensemble-dac.yaml
```yaml
# SPDX-License-Identifier: GPL-2.0-only OR BSD-2-Clause
%YAML 1.2
---
$id: http://devicetree.org/schemas/iio/dac/alif,ensemble-dac.yaml#
$schema: http://devicetree.org/meta-schemas/core.yaml#

title: ALIF Ensemble DAC

description: |
  Schema for the DAC (Digital-to-Analog Converter) nodes found on the ALIF ENSEMBLE SoC.

maintainers:
  - Hemanth Kumar <hemanth@alifsemi.com>

properties:
  compatible:
    const: alif,ensemble-dac

  reg:
    maxItems: 1

  clocks:
    minItems: 2
    maxItems: 2

  clock-names:
    items:
      - const: dac_clk
      - const: cmp_clk

required:
  - compatible
  - reg
  - clocks
  - clock-names

additionalProperties: false

examples:
  - |
    #include <dt-bindings/clock/alif,ensemble-clock.h>

    dac12_0: dac@49028000 {
        compatible = "alif,ensemble-dac";
        reg = <0x49028000 0x10>;
        clocks = <&psclks ENSEMBLE_DAC120_CLK>,
                 <&psclks ENSEMBLE_CMP0_CLK>;
        clock-names = "dac_clk", "cmp_clk";
    };

    dac12_1: dac@49029000 {
        compatible = "alif,ensemble-dac";
        reg = <0x49029000 0x10>;
        clocks = <&psclks ENSEMBLE_DAC121_CLK>,
                 <&psclks ENSEMBLE_CMP0_CLK>;
        clock-names = "dac_clk", "cmp_clk";
    };
```
